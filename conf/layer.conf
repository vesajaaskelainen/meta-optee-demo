## conf/layer.conf
```bitbake
# We have a conf and classes directory, add to BBPATH
BBPATH .= ":${LAYERDIR}"

# We have recipes-* directories, add to BBFILES
BBFILES += "${LAYERDIR}/recipes-*/*/*.bb \
            ${LAYERDIR}/recipes-*/*/*.bbappend"

BBFILE_COLLECTIONS += "meta-optee-demo"
BBFILE_PATTERN_meta-optee-demo = "^${LAYERDIR}/"
BBFILE_PRIORITY_meta-optee-demo = "6"

LAYERDEPENDS_meta-optee-demo = "core"
LAYERSERIES_COMPAT_meta-optee-demo = "kirkstone"

USERADD_GID_TABLES += "files/optee-demo.group"
```
